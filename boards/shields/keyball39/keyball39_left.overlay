#include "keyball39.dtsi"
#include "keyball39_usb_logging.overlay"

&kscan {
    col-gpios
        = <&pro_micro 4 GPIO_ACTIVE_HIGH>   /* COL0: D4 */
        , <&pro_micro 5 GPIO_ACTIVE_HIGH>   /* COL1: C6 (D5) */
        , <&pro_micro 6 GPIO_ACTIVE_HIGH>   /* COL2: D7 (D6) */
        , <&pro_micro 7 GPIO_ACTIVE_HIGH>   /* COL3: E6 (D7) */
        , <&pro_micro 8 GPIO_ACTIVE_HIGH>   /* COL4: B4 (D8) */
        , <&pro_micro 9 GPIO_ACTIVE_HIGH>   /* COL5: B5 (D9) */
        ;
};

&keyball39_trackball_listener {
    status = "disabled";
};

&keyball39_trackball_split {
    status = "disabled";
};
