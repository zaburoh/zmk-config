#include "zaburoh.dtsi"

&default_transform {
    col-offset = <4>;
};

&kscan {
    col-gpios
        = <&xiao_d 0 GPIO_ACTIVE_LOW>
        , <&xiao_d 1 GPIO_ACTIVE_LOW>
        , <&xiao_d 2 GPIO_ACTIVE_LOW>
        ;

    row-gpios
        = <&xiao_d 3 (GPIO_ACTIVE_LOW | GPIO_PULL_UP)>
        , <&xiao_d 4 (GPIO_ACTIVE_LOW | GPIO_PULL_UP)>
        ;
};
