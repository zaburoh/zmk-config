#include "keyball39.dtsi"
#include "keyball39_usb_logging.overlay"

&default_transform {
    col-offset = <6>;
};

&kscan {
    col-gpios
        = <&pro_micro 8 GPIO_ACTIVE_HIGH>
        , <&pro_micro 9 GPIO_ACTIVE_HIGH>
        , <&pro_micro 10 GPIO_ACTIVE_HIGH>
        , <&pro_micro 14 GPIO_ACTIVE_HIGH>
        , <&pro_micro 15 GPIO_ACTIVE_HIGH>
        , <&pro_micro 16 GPIO_ACTIVE_HIGH>
        ;
};

&keyball39_trackball_split {
    status = "disabled";
};
