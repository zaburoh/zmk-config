#include <dt-bindings/zmk/matrix_transform.h>

/ {
    chosen {
        zmk,kscan = &k;
    };

    k: kscan {
        compatible = "zmk,kscan-gpio-direct";
        input-gpios =
            <&xiao_d 2 (GPIO_ACTIVE_LOW | GPIO_PULL_UP)>
        ;
    };
};