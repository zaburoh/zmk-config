## boards/shields/keyball39/Kconfig.defconfig
```kconfig
if SHIELD_KEYBALL39_RIGHT

config ZMK_KEYBOARD_NAME
    default "keyball39"

config ZMK_SPLIT_ROLE_CENTRAL
    default y

endif # SHIELD_KEYBALL39_RIGHT

if SHIELD_KEYBALL39_LEFT || SHIELD_KEYBALL39_RIGHT

config ZMK_SPLIT
    default y

config ZMK_USB
    default y

config ZMK_USB_LOGGING
    default y

config LOG
    default y

config LOG_BACKEND_USB
    default y

endif # SHIELD_KEYBALL39_LEFT || SHIELD_KEYBALL39_RIGHT
```

## boards/shields/zaburoh/Kconfig.defconfig
```kconfig
if SHIELD_ZABUROH

config ZMK_KEYBOARD_NAME
    default "zaburoh"

endif # SHIELD_ZABUROH
```

## boards/shields/zaburoh_right/Kconfig.shield
```kconfig
config SHIELD_ZABUROH_LEFT
    def_bool $(shields_list_contains,zaburoh_left)

config SHIELD_ZABUROH_RIGHT
    def_bool $(shields_list_contains,zaburoh_right)
```

## boards/shields/zaburoh_split/Kconfig.defconfig
```kconfig
if SHIELD_ZABUROH_LEFT

config ZMK_KEYBOARD_NAME
    default "zaburoh-split"

config ZMK_SPLIT_ROLE_CENTRAL
    default y

endif # SHIELD_ZABUROH_LEFT

if SHIELD_ZABUROH_RIGHT

config ZMK_POINTING
    default y

endif #  SHIELD_ZABUROH_RIGHT

if SHIELD_ZABUROH_LEFT || SHIELD_ZABUROH_RIGHT

config ZMK_SPLIT
    default y
endif # SHIELD_ZABUROH_LEFT || SHIELD_ZABUROH_RIGHT
```

## boards/shields/zaburoh_stick/Kconfig.defconfig
```kconfig
if SHIELD_ZABUROH_STICK

config ZMK_KEYBOARD_NAME
    default "zaburoh_stick"

config ZMK_POINTING
    default y

config INPUT
    default y

config ADC
    default y

config ADC_ASYNC
    default y

config ANALOG_INPUT
    default y

config ANALOG_INPUT_LOG_DBG_RAW
    default y

config LOG_DEFAULT_LEVEL
    default 3

config EC11
    default y

config EC11_TRIGGER_GLOBAL_THREAD
    default y

endif # SHIELD_ZABUROH_STICK
```

## dts/bindings/input/zmk,joystick-analog.yaml
```yaml
# Copyright (c) 2026 The ZMK Contributors
# SPDX-License-Identifier: MIT

description: Analog joystick input device producing relative X/Y events.

compatible: "zmk,joystick-analog"

include: [base.yaml]

properties:
  io-channels:
    required: true
    type: phandle-array

  poll-interval-ms:
    type: int
    default: 10

  deadzone:
    type: int
    default: 100

  scale-divisor:
    type: int
    default: 128

  invert-x:
    type: boolean

  invert-y:
    type: boolean
```

## modules/keyball39_pmw3360/drivers/input/Kconfig
```kconfig
config ZMK_INPUT_PMW3360
    bool "PMW3360 input device"
    default y
    depends on DT_HAS_ZMK_PMW3360_ENABLED
    select SPI
    help
      Enable the PMW3360 SPI input device driver.
```

## modules/keyball39_pmw3360/dts/bindings/input/zmk,pmw3360.yaml
```yaml
# Copyright (c) 2026 The ZMK Contributors
# SPDX-License-Identifier: MIT

description: PMW3360 optical sensor input device over SPI

compatible: "zmk,pmw3360"

include: [spi-device.yaml]

properties:
  polling-interval-ms:
    type: int
    default: 4
    description: Polling interval in milliseconds.
  cpi:
    type: int
    default: 500
    description: CPI setting in counts per inch (e.g. 500, 1000).
```

## zephyr/Kconfig
```kconfig
menu "ZMK Config Extras"

config ZMK_JOYSTICK_ANALOG
    bool "Analog joystick input device"
    depends on ZMK_POINTING
    select ADC
    default y if SHIELD_ZABUROH_STICK
    help
      Enable the analog joystick input device.

endmenu
```

## zephyr/dts/bindings/input/zmk,joystick-analog.yaml
```yaml
# Copyright (c) 2026 The ZMK Contributors
# SPDX-License-Identifier: MIT

description: Analog joystick input device producing relative X/Y events.

compatible: "zmk,joystick-analog"

include: [base.yaml]

properties:
  x-adc:
    required: true
    type: phandle

  x-channel:
    required: true
    type: int

  y-adc:
    required: true
    type: phandle

  y-channel:
    required: true
    type: int

  poll-interval-ms:
    type: int
    default: 10

  deadzone:
    type: int
    default: 100

  scale-divisor:
    type: int
    default: 128

  invert-x:
    type: boolean

  invert-y:
    type: boolean
```
